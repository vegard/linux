## kernel/cpp/Kconfig
```kconfig
menuconfig CPP
	bool "C++ runtime support"
	help
	  This enables C++ runtime support.

if CPP

config CPP_LIBUNWIND_DEBUG
	bool "libunwind debugging"
	help
	  This enables detailed libunwind debug output in the kernel log.

endif # CPP
```

## scripts/kconfig/satconf-tests/Kconfig.ASN1
```kconfig
config MODULES
  bool "Enable loadable module support"
  option modules

config ASN1
  tristate

config CRYPTO_RSA
  tristate "RSA algorithm"
  select ASN1

===testcases

# A select from an 'm' variable should result in 'y' for the selected
# symbol.
---
input:
  CRYPTO_RSA: m
output:
  ASN1: y
...

# We should not be able to set ASN1=m just because it gets selected by
# something else -- the select should only result in ASN1=y.
---
input:
  ASN1: m
  CRYPTO_RSA: y
failure: true
...
```

## scripts/kconfig/satconf-tests/Kconfig.CRYPTO_ALGAPI2
```kconfig
config MODULES
  bool "Enable loadable module support"
  option modules

config CRYPTO_ALGAPI2
  tristate

config CRYPTO_HASH2
  tristate
  select CRYPTO_ALGAPI2

config CRYPTO_MANAGER2
  tristate
  default m
  select CRYPTO_HASH2

===testcases

---
input:
  MODULES: y
  CRYPTO_ALGAPI2: y
  CRYPTO_HASH2: y
  CRYPTO_MANAGER2: m
...
```

## scripts/kconfig/satconf-tests/Kconfig.HAS_IOMEM
```kconfig
# According to menuconfig, the only possible assignment is y to both.
# Neither symbol has any prompt, so the defaults are used. But selects
# override defaults, so HAS_IOMEM's select of GENERIC_IO causes both
# symbols to get a final value of y.

config MODULES
  bool "Enable loadable module support"
  modules

config GENERIC_IO
	bool
	default n

config HAS_IOMEM
	bool
	select GENERIC_IO
	default y

===testcases

---
output:
 GENERIC_IO: y
 HAS_IOMEM: y
...

---
input:
 GENERIC_IO: n
failure: true
...

---
input:
 HAS_IOMEM: n
failure: true
...
```

## scripts/kconfig/satconf-tests/Kconfig.JBD2
```kconfig
config MODULES
  bool "Enable loadable module support"
  option modules

config JBD2
  tristate

config EXT4_FS
  tristate "The Extended 4 (ext4) filesystem"
  select JBD2

===testcases

---
input:
  EXT4_FS: y
output:
  JBD2: y
...
```

## scripts/kconfig/satconf-tests/Kconfig.PAGE_POISONING
```kconfig
config MODULES
  bool "Enable loadable module support"
  option modules

config ARCH_SUPPORTS_DEBUG_PAGEALLOC
  def_bool y

config PAGE_POISONING
  bool

config DEBUG_PAGEALLOC
  bool "Debug page memory allocations"
  select PAGE_POISONING if !ARCH_SUPPORTS_DEBUG_PAGEALLOC

===testcases

---
input:
  DEBUG_PAGEALLOC: y
output:
  PAGE_POISONING: n
...
```

## scripts/kconfig/satconf-tests/Kconfig.PREEMPT
```kconfig
config MODULES
  bool "Enable loadable module support"
  option modules

choice
	prompt "Preemption Model"
	default PREEMPT_NONE

config PREEMPT_NONE
	bool "No Forced Preemption (Server)"

config PREEMPT_VOLUNTARY
	bool "Voluntary Kernel Preemption (Desktop)"

config PREEMPT
	bool "Preemptible Kernel (Low-Latency Desktop)"

endchoice

===testcases

# We force the default off. This should not generate a conflict, but
# choose a different choice.
---
input:
  PREEMPT_NONE: n
...

# We force another choice than the default. This should not generate a
# conflict, but use the value we forced.
---
input:
  PREEMPT_VOLUNTARY: y
...
```

## scripts/kconfig/satconf-tests/Kconfig.SHMEM
```kconfig
config MODULES
  bool "Enable loadable module support"
  option modules

config MMU
	def_bool y

menuconfig EXPERT
	bool "Configure standard kernel features (expert users)"

config SHMEM
	bool "Use full shmem filesystem" if EXPERT
	default y
	depends on MMU

config TMPFS
	bool "Tmpfs virtual memory file system support (former shm fs)"
	depends on SHMEM

===testcases

---
input:
  EXPERT: n
  TMPFS: y
output:
  SHMEM: y
...

# Without a prompt for SHMEM, it should use the default value of 'y'
---
input:
  EXPERT: n
  TMPFS: n
output:
  SHMEM: y
...
```

## scripts/kconfig/satconf-tests/Kconfig.WIZNET
```kconfig
config MODULES
  bool "Enable loadable module support"
  option modules

config WIZNET_W5100
        tristate "WIZnet W5100 Ethernet support"
        depends on HAS_IOMEM

config WIZNET_W5300
        tristate "WIZnet W5300 Ethernet support"
        depends on HAS_IOMEM

choice
        prompt "WIZnet interface mode"
        depends on WIZNET_W5100 || WIZNET_W5300
        default WIZNET_BUS_ANY

config WIZNET_BUS_DIRECT
        bool "Direct address bus mode"

config WIZNET_BUS_INDIRECT
        bool "Indirect address bus mode"

config WIZNET_BUS_ANY
        bool "Select interface mode in runtime"

endchoice

===testcases

# The choice block is not visible since its dependencies are not met.
# Therefore, none of the choices should be selectable either.
---
input:
  WIZNET_W5100: n
  WIZNET_W5300: n
output:
  WIZNET_BUS_DIRECT: n
  WIZNET_BUS_INDIRECT: n
  WIZNET_BUS_ANY: n
...
```
